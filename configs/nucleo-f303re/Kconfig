## configs/nucleo-f303re/Kconfig
```kconfig
#
# For a description of the syntax of this configuration file,
# see the file kconfig-language.txt in the NuttX tools repository.
#

if ARCH_BOARD_NUCLEO_F303RE

config NUCLEO_F303RE_QETIMER
	int "Timer to use with QE encoder"
	default 3
	depends on QENCODER

endif # ARCH_BOARD_NUCLEO_F303RE
```
